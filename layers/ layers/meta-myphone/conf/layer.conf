## layers/ layers/meta-myphone/conf/layer.conf
```bitbake
BBPATH .= ":${LAYERDIR}"
BBFILES += "${LAYERDIR}/recipes-*/*/*.bb \
            ${LAYERDIR}/recipes-*/*/*.bbappend"

BBFILE_COLLECTIONS += "meta-myphone"
BBFILE_PATTERN_meta-myphone = "^${LAYERDIR}/"
BBFILE_PRIORITY_meta-myphone = "10"

LAYERDEPENDS_meta-myphone = "core raspberrypi openembedded-layer"
LAYERSERIES_COMPAT_meta-myphone = "kirkstone"
```

## layers/meta-myphone-apps/conf/layer.conf
```bitbake
BBPATH .= ":${LAYERDIR}"
BBFILES += "${LAYERDIR}/recipes-*/*/*.bb \
            ${LAYERDIR}/recipes-*/*/*.bbappend"

BBFILE_COLLECTIONS += "meta-myphone-apps"
BBFILE_PATTERN_meta-myphone-apps = "^${LAYERDIR}/"
BBFILE_PRIORITY_meta-myphone-apps = "8"

LAYERDEPENDS_meta-myphone-apps = "core meta-myphone-ui"
LAYERSERIES_COMPAT_meta-myphone-apps = "scarthgap"
```

## layers/meta-myphone-bsp/conf/layer.conf
```bitbake
# We have a conf and classes directory, add to BBPATH
BBPATH .= ":${LAYERDIR}"

# We have recipes-* directories, add to BBFILES
BBFILES += "${LAYERDIR}/recipes-*/*/*.bb \
            ${LAYERDIR}/recipes-*/*/*.bbappend"

BBFILE_COLLECTIONS += "meta-myphone-bsp"
BBFILE_PATTERN_meta-myphone-bsp = "^${LAYERDIR}/"
BBFILE_PRIORITY_meta-myphone-bsp = "6"

LAYERDEPENDS_meta-myphone-bsp = "core raspberrypi"
LAYERSERIES_COMPAT_meta-myphone-bsp = "scarthgap"
```

## layers/meta-myphone-security/conf/layer.conf
```bitbake
BBPATH .= ":${LAYERDIR}"
BBFILES += "${LAYERDIR}/recipes-*/*/*.bb \
            ${LAYERDIR}/recipes-*/*/*.bbappend"

BBFILE_COLLECTIONS += "meta-myphone-security"
BBFILE_PATTERN_meta-myphone-security = "^${LAYERDIR}/"
BBFILE_PRIORITY_meta-myphone-security = "9"

LAYERDEPENDS_meta-myphone-security = "core"
LAYERSERIES_COMPAT_meta-myphone-security = "scarthgap"
```

## layers/meta-myphone-ui/conf/layer.conf
```bitbake
# We have a conf and classes directory, add to BBPATH
BBPATH .= ":${LAYERDIR}"

# We have recipes-* directories, add to BBFILES
BBFILES += "${LAYERDIR}/recipes-*/*/*.bb \
            ${LAYERDIR}/recipes-*/*/*.bbappend"

BBFILE_COLLECTIONS += "meta-myphone-ui"
BBFILE_PATTERN_meta-myphone-ui = "^${LAYERDIR}/"
BBFILE_PRIORITY_meta-myphone-ui = "7"

LAYERDEPENDS_meta-myphone-ui = "core meta-myphone-bsp"
LAYERSERIES_COMPAT_meta-myphone-ui = "scarthgap"
```

## layers/meta-myphone-update/conf/layer.conf
```bitbake
BBPATH .= ":${LAYERDIR}"
BBFILES += "${LAYERDIR}/recipes-*/*/*.bb \
            ${LAYERDIR}/recipes-*/*/*.bbappend"

BBFILE_COLLECTIONS += "meta-myphone-update"
BBFILE_PATTERN_meta-myphone-update = "^${LAYERDIR}/"
BBFILE_PRIORITY_meta-myphone-update = "10"

LAYERDEPENDS_meta-myphone-update = "core"
LAYERSERIES_COMPAT_meta-myphone-update = "scarthgap"
```
